#include <dt-bindings/led/led.h>

&pinctrl {
    spi3_default: spi3_default {
        group1 {
            psels = <NRF_PSEL(SPIM_MOSI, 0, 6)>;
        };
    };

    spi3_sleep: spi3_sleep {
        group1 {
            psels = <NRF_PSEL(SPIM_MOSI, 0, 6)>;
            low-power-enable;
        };
    };

    // Updated pin control for backlight (port 1, pin 11)
    backlight_default: backlight_default {
        group1 {
            psels = <NRF_PSEL(GPIO, 1, 11)>;
        };
    };
};

&spi3 {
    compatible = "nordic,nrf-spim";
    status = "okay";

    pinctrl-0 = <&spi3_default>;
    pinctrl-1 = <&spi3_sleep>;
    pinctrl-names = "default", "sleep";

    led_strip: ws2812@0 {
        compatible = "worldsemi,ws2812-spi";

        /* SPI */
        reg = <0>;
        spi-max-frequency = <4000000>;

        /* WS2812 */
        chain-length = <10>;
        spi-one-frame = <0x70>;
        spi-zero-frame = <0x40>;

        color-mapping = <LED_COLOR_ID_GREEN LED_COLOR_ID_RED LED_COLOR_ID_BLUE>;
    };
};

// Backlight LED node with updated GPIO pin
backlight: backlight@1 {
    compatible = "gpio-leds";
    pinctrl-0 = <&backlight_default>;
    pinctrl-names = "default";

    leds {
        led0 {
            gpios = <&gpio1 11 GPIO_ACTIVE_HIGH>; /* Port 1, Pin 11 */
            label = "backlight";
            default-state = "off";
            max-brightness = <255>; /* Optional: max brightness level */
        };
    };
};

/ {
    chosen {
        zmk,underglow = &led_strip;
        zmk,backlight = &backlight;
    };
};