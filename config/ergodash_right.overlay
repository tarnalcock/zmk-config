/*
 * Copyright (c) 2020 The ZMK Contributors
 *
 * SPDX-License-Identifier: MIT
 */

#include "ergodash.dtsi"

/ {
    zmk,split-role = "right";  // Set this on the right half
};

&pro_micro_i2c {
    status = "disabled";  // Disables the display on the right side
};

&default_transform {
    col-offset = <7>;
};
